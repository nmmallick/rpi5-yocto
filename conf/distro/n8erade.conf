## conf/layer.conf
```bitbake
# We have a conf and classes directory, add to BBPATH
BBPATH .= ":${LAYERDIR}"

# We have recipes-* directories, add to BBFILES
BBFILES += "${LAYERDIR}/recipes-*/*/*.bb \
            ${LAYERDIR}/recipes-*/*/*.bbappend"

BBFILE_COLLECTIONS+="rpi5-yocto"
BBFILE_PATTERN_rpi5-yocto := "^${LAYERDIR}/"

BBFILE_PRIORITY_rpi5-yocto = "6"

LAYERDEPENDS_rpi5_yocto += "raspberrypi"

DISTRO = "n8erade"
DISTRO_VERSION = "0.0.1"

IMAGE_INSTALL:append = " rpi-users "
```
